## configs/sc573-ezkit_defconfig
```kconfig
CONFIG_ARM=y
CONFIG_SC57X=y
CONFIG_SYS_TEXT_BASE=0x82200000
CONFIG_NR_DRAM_BANKS=1
CONFIG_ENV_SIZE=0x2000
CONFIG_ENV_OFFSET=0x78000
CONFIG_ENV_SECT_SIZE=0x8000
CONFIG_ADI_SPI3_DM=y
CONFIG_DEFAULT_DEVICE_TREE="sc573-ezkit"
CONFIG_FIT=y
CONFIG_FIT_SIGNATURE=y
CONFIG_LEGACY_IMAGE_FORMAT=y
CONFIG_CLKIN_HZ=25000000
CONFIG_CGU0_VCO_MULT=18
CONFIG_CGU0_DF_DIV=0
CONFIG_CGU0_CCLK_DIV=1
CONFIG_CGU0_SCLK_DIV=2
CONFIG_CGU0_SCLK0_DIV=2
CONFIG_CGU0_SCLK1_DIV=2
CONFIG_CGU0_DCLK_DIV=2
CONFIG_CGU0_OCLK_DIV=3
CONFIG_CGU1_VCO_MULT=5
CONFIG_CGU1_DF_DIV=0
CONFIG_CGU1_CCLK_DIV=1
CONFIG_CGU1_SCLK_DIV=2
CONFIG_CGU1_SCLK0_DIV=2
CONFIG_CGU1_SCLK1_DIV=2
CONFIG_CGU1_DCLK_DIV=2
CONFIG_CGU1_OCLK_DIV=3
CONFIG_CDU0_CLKO0=1
CONFIG_CDU0_CLKO1=1
CONFIG_CDU0_CLKO2=1
CONFIG_CDU0_CLKO3=1
CONFIG_CDU0_CLKO4=1
CONFIG_CDU0_CLKO5=1
CONFIG_CDU0_CLKO6=1
CONFIG_CDU0_CLKO7=5
CONFIG_CDU0_CLKO8=1
CONFIG_CDU0_CLKO9=1
CONFIG_CMD_BOOTZ=y
# CONFIG_BOOTM_NETBSD is not set
# CONFIG_BOOTM_PLAN9 is not set
# CONFIG_BOOTM_RTEMS is not set
# CONFIG_BOOTM_VXWORKS is not set
# CONFIG_CMD_BOOTEFI is not set
# CONFIG_CMD_ELF is not set
CONFIG_CMD_DM=y
CONFIG_CMD_GPIO=y
CONFIG_CMD_I2C=y
CONFIG_CMD_MMC=y
CONFIG_CMD_SPI=y
CONFIG_CMD_USB=y
CONFIG_CMD_DHCP=y
CONFIG_CMD_EXT2=y
CONFIG_CMD_FAT=y
CONFIG_CMD_FS_GENERIC=y
CONFIG_OF_CONTROL=y
CONFIG_OF_EMBED=y
# CONFIG_ENV_IS_NOWHERE is not set
CONFIG_ENV_IS_IN_SPI_FLASH=y
CONFIG_USE_ENV_SPI_BUS=y
CONFIG_ENV_SPI_BUS=2
CONFIG_USE_ENV_SPI_CS=y
CONFIG_ENV_SPI_CS=1
CONFIG_USE_ENV_SPI_MAX_HZ=y
CONFIG_ENV_SPI_MAX_HZ=10000000
CONFIG_IP_DEFRAG=y
CONFIG_DM=y
CONFIG_DM_SPI_FLASH=y
CONFIG_SF_DEFAULT_BUS=2
CONFIG_SF_DEFAULT_CS=1
CONFIG_ETH_DESIGNWARE=y
CONFIG_SPECIFY_CONSOLE_INDEX=y
CONFIG_DM_SERIAL=y
CONFIG_SPI=y
CONFIG_DM_SPI=y
CONFIG_USB=y
CONFIG_USB_MUSB_HCD=y
```

## configs/sc584-ezkit_defconfig
```kconfig
CONFIG_ARM=y
CONFIG_SC58X=y
CONFIG_SYS_TEXT_BASE=0x89200000
CONFIG_NR_DRAM_BANKS=1
CONFIG_ENV_SIZE=0x2000
CONFIG_ENV_OFFSET=0x78000
CONFIG_ENV_SECT_SIZE=0x2000
CONFIG_CGU0_DF_DIV=0
CONFIG_CGU0_VCO_MULT=18
CONFIG_CGU0_CCLK_DIV=1
CONFIG_CGU0_SCLK_DIV=2
CONFIG_CGU0_SCLK0_DIV=2
CONFIG_CGU0_SCLK1_DIV=2
CONFIG_CGU0_DCLK_DIV=2
CONFIG_CGU0_OCLK_DIV=3
CONFIG_CGU1_VCO_MULT=5
CONFIG_CGU1_DF_DIV=0
CONFIG_CGU1_CCLK_DIV=1
CONFIG_CGU1_SCLK_DIV=2
CONFIG_CGU1_SCLK0_DIV=2
CONFIG_CGU1_SCLK1_DIV=2
CONFIG_CGU1_DCLK_DIV=2
CONFIG_CGU1_OCLK_DIV=3
CONFIG_CDU0_CLKO0=1
CONFIG_CDU0_CLKO1=1
CONFIG_CDU0_CLKO2=1
CONFIG_CDU0_CLKO3=1
CONFIG_CDU0_CLKO4=1
CONFIG_CDU0_CLKO5=1
CONFIG_CDU0_CLKO6=1
CONFIG_CDU0_CLKO7=5
CONFIG_CDU0_CLKO8=1
CONFIG_CDU0_CLKO9=1
CONFIG_TARGET_SC584_EZKIT=y
CONFIG_DM_GPIO=y
CONFIG_DEFAULT_DEVICE_TREE="sc584-ezkit"
CONFIG_FIT=y
CONFIG_FIT_SIGNATURE=y
CONFIG_LEGACY_IMAGE_FORMAT=y
CONFIG_CMD_MMC=y
CONFIG_CMD_SPI=y
CONFIG_CMD_USB=y
CONFIG_CMD_EXT2=y
CONFIG_CMD_FAT=y
CONFIG_CMD_FS_GENERIC=y
CONFIG_OF_CONTROL=y
CONFIG_OF_EMBED=y
CONFIG_ENV_IS_IN_SPI_FLASH=y
CONFIG_USE_ENV_SPI_BUS=y
CONFIG_ENV_SPI_BUS=2
CONFIG_USE_ENV_SPI_CS=y
CONFIG_ENV_SPI_CS=1
CONFIG_IP_DEFRAG=y
CONFIG_DM=y
CONFIG_GPIO_HOG=y
CONFIG_DM_GPIO_LOOKUP_LABEL=y
CONFIG_DM_SPI_FLASH=y
CONFIG_SF_DEFAULT_BUS=2
CONFIG_SF_DEFAULT_CS=1
CONFIG_ETH_DESIGNWARE=y
CONFIG_SPECIFY_CONSOLE_INDEX=y
CONFIG_DM_SERIAL=y
CONFIG_SPI=y
CONFIG_DM_SPI=y
CONFIG_USB=y
CONFIG_USB_MUSB_HCD=y
```

## configs/sc589-ezkit_defconfig
```kconfig
CONFIG_ARM=y
CONFIG_SYS_ARM_CACHE_WRITETHROUGH=y
CONFIG_TARGET_SC589_EZKIT=y
CONFIG_SYS_TEXT_BASE=0xC2200000
CONFIG_SPL_GPIO_SUPPORT=y
CONFIG_SPL_LIBCOMMON_SUPPORT=y
CONFIG_SPL_LIBGENERIC_SUPPORT=y
CONFIG_SYS_MALLOC_F_LEN=0x8000
CONFIG_NR_DRAM_BANKS=1
CONFIG_ENV_SIZE=0x4000
CONFIG_ENV_OFFSET=0xE0000
CONFIG_ENV_SECT_SIZE=0x4000
CONFIG_DM_GPIO=y
CONFIG_SPL_TEXT_BASE=0x20080000
CONFIG_SPL_SERIAL_SUPPORT=y
CONFIG_SPL=y
CONFIG_CGU0_DF_DIV=0
CONFIG_CGU0_VCO_MULT=18
CONFIG_CGU0_CCLK_DIV=1
CONFIG_CGU0_SCLK_DIV=2
CONFIG_CGU0_SCLK0_DIV=2
CONFIG_CGU0_SCLK1_DIV=2
CONFIG_CGU0_DCLK_DIV=1
CONFIG_CGU0_OCLK_DIV=3
CONFIG_CGU1_VCO_MULT=5
CONFIG_CGU1_DF_DIV=0
CONFIG_CGU1_CCLK_DIV=1
CONFIG_CGU1_SCLK_DIV=2
CONFIG_CGU1_SCLK0_DIV=2
CONFIG_CGU1_SCLK1_DIV=2
CONFIG_CGU1_DCLK_DIV=2
CONFIG_CGU1_OCLK_DIV=3
CONFIG_CDU0_CLKO0=1
CONFIG_CDU0_CLKO1=1
CONFIG_CDU0_CLKO2=1
CONFIG_CDU0_CLKO3=1
CONFIG_CDU0_CLKO4=1
CONFIG_CDU0_CLKO5=1
CONFIG_CDU0_CLKO6=1
CONFIG_CDU0_CLKO7=5
CONFIG_CDU0_CLKO8=1
CONFIG_CDU0_CLKO9=1
CONFIG_DEFAULT_DEVICE_TREE="sc589-ezkit"
CONFIG_FIT=y
CONFIG_FIT_SIGNATURE=y
CONFIG_LEGACY_IMAGE_FORMAT=y
CONFIG_BOARD_EARLY_INIT_F=y
CONFIG_SPL_BOOTROM_SUPPORT=y
# CONFIG_SPL_RAW_IMAGE_SUPPORT is not set
# CONFIG_SPL_LEGACY_IMAGE_SUPPORT is not set
CONFIG_SPL_I2C_SUPPORT=y
CONFIG_CMD_BOOTZ=y
# CONFIG_BOOTM_NETBSD is not set
# CONFIG_BOOTM_PLAN9 is not set
# CONFIG_BOOTM_RTEMS is not set
# CONFIG_BOOTM_VXWORKS is not set
# CONFIG_CMD_ELF is not set
CONFIG_CMD_DM=y
CONFIG_CMD_GPIO=y
CONFIG_CMD_I2C=y
CONFIG_CMD_MMC=y
# CONFIG_CMD_PINMUX is not set
CONFIG_CMD_SPI=y
CONFIG_CMD_USB=y
CONFIG_CMD_DHCP=y
CONFIG_CMD_MII=y
# CONFIG_CMD_MDIO is not set
CONFIG_CMD_PING=y
CONFIG_CMD_DNS=y
CONFIG_CMD_EXT4=y
CONFIG_CMD_EXT4_WRITE=y
CONFIG_CMD_FAT=y
CONFIG_CMD_FS_GENERIC=y
CONFIG_SPL_OF_CONTROL=y
CONFIG_OF_EMBED=y
CONFIG_ENV_OVERWRITE=y
CONFIG_ENV_IS_IN_SPI_FLASH=y
CONFIG_USE_ENV_SPI_BUS=y
CONFIG_ENV_SPI_BUS=2
CONFIG_USE_ENV_SPI_CS=y
CONFIG_ENV_SPI_CS=1
CONFIG_USE_ENV_SPI_MAX_HZ=y
CONFIG_ENV_SPI_MAX_HZ=10000000
CONFIG_IP_DEFRAG=y
CONFIG_SPL_DM=y
CONFIG_SPL_DM_SEQ_ALIAS=y
# CONFIG_BLK is not set
CONFIG_SPL_CLK=y
CONFIG_SPL_CLK_CCF=y
CONFIG_GPIO_HOG=y
CONFIG_DM_GPIO_LOOKUP_LABEL=y
CONFIG_SPL_DM_GPIO_LOOKUP_LABEL=y
CONFIG_MCP2301X_GPIO=y
CONFIG_DM_I2C=y
CONFIG_SYS_I2C_ADI=y
CONFIG_DM_MMC=y
CONFIG_MMC_DW=y
CONFIG_MMC_DW_SNPS=y
CONFIG_DM_SPI_FLASH=y
CONFIG_SF_DEFAULT_BUS=2
CONFIG_SF_DEFAULT_CS=1
CONFIG_SPI_FLASH_WINBOND=y
CONFIG_DM_ETH=y
CONFIG_ETH_DESIGNWARE=y
CONFIG_PINCTRL=y
# CONFIG_PINCTRL_GENERIC is not set
CONFIG_SPL_PINCTRL=y
# CONFIG_SPL_PINCTRL_GENERIC is not set
CONFIG_SPECIFY_CONSOLE_INDEX=y
CONFIG_DM_SERIAL=y
CONFIG_SPI=y
CONFIG_DM_SPI=y
CONFIG_ADI_SPI3_DM=y
CONFIG_SPL_TIMER=y
CONFIG_USB=y
CONFIG_USB_MUSB_HCD=y
CONFIG_USB_SC5XX=y
CONFIG_FAT_WRITE=y
# CONFIG_REGEX is not set
# CONFIG_EFI_LOADER is not set
```

## configs/sc589-mini_defconfig
```kconfig
CONFIG_ARM=y
CONFIG_SYS_ARM_CACHE_WRITETHROUGH=y
CONFIG_ARCH_SC5XX=y
CONFIG_TEXT_BASE=0xC2200000
CONFIG_SYS_MALLOC_F_LEN=0x14000
CONFIG_SPL_GPIO=y
CONFIG_SPL_LIBCOMMON_SUPPORT=y
CONFIG_SPL_LIBGENERIC_SUPPORT=y
CONFIG_NR_DRAM_BANKS=1
CONFIG_HAS_CUSTOM_SYS_INIT_SP_ADDR=y
CONFIG_CUSTOM_SYS_INIT_SP_ADDR=0xC203F000
CONFIG_ENV_SIZE=0x10000
CONFIG_ENV_OFFSET=0xD0000
CONFIG_ENV_SECT_SIZE=0x10000
CONFIG_DM_GPIO=y
CONFIG_DEFAULT_DEVICE_TREE="sc589-mini"
CONFIG_SPL_TEXT_BASE=0x20080000
CONFIG_SPL_SERIAL=y
CONFIG_SPL=y
CONFIG_TARGET_SC589_MINI=y
CONFIG_WATCHDOG_TIMEOUT_MSECS=60000
CONFIG_CGU0_DF_DIV=0
CONFIG_CGU0_VCO_MULT=18
CONFIG_CGU0_CCLK_DIV=1
CONFIG_CGU0_SCLK_DIV=2
CONFIG_CGU0_SCLK0_DIV=2
CONFIG_CGU0_SCLK1_DIV=2
CONFIG_CGU0_DCLK_DIV=1
CONFIG_CGU0_OCLK_DIV=3
CONFIG_CGU1_VCO_MULT=5
CONFIG_CGU1_DF_DIV=0
CONFIG_CGU1_CCLK_DIV=1
CONFIG_CGU1_SCLK_DIV=2
CONFIG_CGU1_SCLK0_DIV=2
CONFIG_CGU1_SCLK1_DIV=2
CONFIG_CGU1_DCLK_DIV=2
CONFIG_CGU1_OCLK_DIV=3
CONFIG_CDU0_CLKO0=1
CONFIG_CDU0_CLKO1=1
CONFIG_CDU0_CLKO2=1
CONFIG_CDU0_CLKO3=1
CONFIG_CDU0_CLKO4=1
CONFIG_CDU0_CLKO5=1
CONFIG_CDU0_CLKO6=1
CONFIG_CDU0_CLKO7=5
CONFIG_CDU0_CLKO8=1
CONFIG_CDU0_CLKO9=1
CONFIG_SYS_LOAD_ADDR=0x0
CONFIG_FIT=y
CONFIG_FIT_SIGNATURE=y
CONFIG_LEGACY_IMAGE_FORMAT=y
CONFIG_BOARD_EARLY_INIT_F=y
CONFIG_SPL_BSS_MAX_SIZE=0x65536
CONFIG_SPL_BOOTROM_SUPPORT=y
# CONFIG_SPL_RAW_IMAGE_SUPPORT is not set
CONFIG_SPL_I2C=y
CONFIG_CMD_BOOTZ=y
# CONFIG_BOOTM_NETBSD is not set
# CONFIG_BOOTM_PLAN9 is not set
# CONFIG_BOOTM_RTEMS is not set
# CONFIG_BOOTM_VXWORKS is not set
# CONFIG_CMD_ELF is not set
CONFIG_CMD_DM=y
CONFIG_CMD_GPIO=y
CONFIG_CMD_I2C=y
CONFIG_CMD_MMC=y
# CONFIG_CMD_PINMUX is not set
CONFIG_CMD_SPI=y
CONFIG_CMD_USB=y
CONFIG_CMD_DHCP=y
CONFIG_CMD_MII=y
# CONFIG_CMD_MDIO is not set
CONFIG_CMD_PING=y
CONFIG_CMD_DNS=y
CONFIG_CMD_EXT4=y
CONFIG_CMD_EXT4_WRITE=y
CONFIG_CMD_FAT=y
CONFIG_CMD_FS_GENERIC=y
CONFIG_SPL_OF_CONTROL=y
CONFIG_OF_EMBED=y
CONFIG_ENV_OVERWRITE=y
CONFIG_ENV_IS_IN_SPI_FLASH=y
CONFIG_ENV_SPI_MAX_HZ=10000000
CONFIG_IP_DEFRAG=y
CONFIG_SPL_DM=y
CONFIG_SPL_DM_SEQ_ALIAS=y
CONFIG_SPL_CLK=y
CONFIG_SPL_CLK_CCF=y
CONFIG_GPIO_HOG=y
CONFIG_SPL_GPIO_HOG=y
CONFIG_DM_GPIO_LOOKUP_LABEL=y
CONFIG_SPL_DM_GPIO_LOOKUP_LABEL=y
CONFIG_DM_I2C=y
CONFIG_DM_I2C_GPIO=y
CONFIG_SYS_I2C_ADI=y
CONFIG_MMC_DW=y
CONFIG_MMC_DW_SNPS=y
CONFIG_DM_SPI_FLASH=y
CONFIG_SF_DEFAULT_BUS=2
CONFIG_SF_DEFAULT_CS=1
CONFIG_SF_DEFAULT_SPEED=5000000
CONFIG_SPI_FLASH_ISSI=y
CONFIG_SPI_FLASH_STMICRO=y
CONFIG_ETH_DESIGNWARE=y
CONFIG_PINCTRL=y
# CONFIG_PINCTRL_GENERIC is not set
CONFIG_SPL_PINCTRL=y
# CONFIG_SPL_PINCTRL_GENERIC is not set
CONFIG_SPECIFY_CONSOLE_INDEX=y
CONFIG_DM_SERIAL=y
CONFIG_SPI=y
CONFIG_DM_SPI=y
CONFIG_ADI_SPI3=y
CONFIG_SPL_TIMER=y
CONFIG_USB=y
CONFIG_USB_MUSB_HOST=y
CONFIG_USB_MUSB_SC5XX=y
CONFIG_USB_MUSB_PIO_ONLY=y
CONFIG_FAT_WRITE=y
# CONFIG_REGEX is not set
# CONFIG_EFI_LOADER is not set
CONFIG_LOG=y
CONFIG_LOG_MAX_LEVEL=6
CONFIG_LOG_DEFAULT_LEVEL=6
CONFIG_LOG_CONSOLE=y
```

## configs/sc594-som-ezkit-falcon_defconfig
```kconfig
CONFIG_ARM=y
CONFIG_SC59X=y
CONFIG_SYS_TEXT_BASE=0xB2200000
CONFIG_SPL_GPIO_SUPPORT=y
CONFIG_SPL_LIBCOMMON_SUPPORT=y
CONFIG_SPL_LIBGENERIC_SUPPORT=y
CONFIG_NR_DRAM_BANKS=1
CONFIG_ENV_SIZE=0x20000
CONFIG_ENV_OFFSET=0x80000
CONFIG_ENV_SECT_SIZE=0x20000
CONFIG_SC_BOOT_MODE=2
# CONFIG_ADI_SPI3 is not set
CONFIG_ADI_FALCON=y
CONFIG_SPL_DM_SPI=y
CONFIG_SPL_TEXT_BASE=0x20080000
CONFIG_SPL_SERIAL_SUPPORT=y
CONFIG_SPL=y
CONFIG_SPL_SPI_FLASH_SUPPORT=y
CONFIG_SPL_SPI_SUPPORT=y
CONFIG_DEFAULT_DEVICE_TREE="sc594-som-ezkit"
# CONFIG_SYS_MALLOC_F is not set
CONFIG_OF_BOARD_SETUP=y
CONFIG_SPL_FRAMEWORK_BOARD_INIT_F=y
CONFIG_SPL_BOOTROM_SUPPORT=y
CONFIG_SPL_I2C_SUPPORT=y
CONFIG_SPL_DM_SPI_FLASH=y
CONFIG_SPL_OS_BOOT=y
CONFIG_SPL_SPI_LOAD=y
CONFIG_CMD_DM=y
# CONFIG_CMD_SF is not set
CONFIG_CMD_SPI=y
CONFIG_OF_CONTROL=y
CONFIG_SPL_OF_CONTROL=y
CONFIG_OF_EMBED=y
CONFIG_ENV_IS_IN_SPI_FLASH=y
CONFIG_USE_ENV_SPI_BUS=y
CONFIG_ENV_SPI_BUS=0
CONFIG_IP_DEFRAG=y
CONFIG_DM=y
CONFIG_SPL_DM=y
CONFIG_SPL_DM_SEQ_ALIAS=y
CONFIG_DM_SPI_FLASH=y
CONFIG_ETH_DESIGNWARE=y
CONFIG_BAUDRATE=57600
CONFIG_SPI=y
CONFIG_DM_SPI=y
CONFIG_USB=y
CONFIG_USB_MUSB_HCD=y
CONFIG_SPL_OF_LIBFDT_ASSUME_MASK=0x0
```

## configs/sc594-som-ezkit-spl_defconfig
```kconfig
CONFIG_ARM=y
CONFIG_SYS_ARM_CACHE_WRITETHROUGH=y
CONFIG_ARCH_SC5XX=y
CONFIG_TEXT_BASE=0xB2200000
CONFIG_SYS_MALLOC_F_LEN=0x14000
CONFIG_SPL_GPIO=y
CONFIG_SPL_LIBCOMMON_SUPPORT=y
CONFIG_SPL_LIBGENERIC_SUPPORT=y
CONFIG_NR_DRAM_BANKS=1
CONFIG_HAS_CUSTOM_SYS_INIT_SP_ADDR=y
CONFIG_CUSTOM_SYS_INIT_SP_ADDR=0xA203f000
CONFIG_ENV_SIZE=0x20000
CONFIG_ENV_OFFSET=0x100000
CONFIG_ENV_SECT_SIZE=0x20000
CONFIG_DM_GPIO=y
CONFIG_SPL_DM_SPI=y
CONFIG_DEFAULT_DEVICE_TREE="sc594-som-ezkit"
CONFIG_SPL_TEXT_BASE=0x20080000
CONFIG_SPL_SERIAL=y
CONFIG_SPL=y
CONFIG_TARGET_SC594_SOM_EZKIT=y
CONFIG_SC_BOOT_MODE=2
CONFIG_ADI_CARRIER_SOMCRR_EZKIT=y
CONFIG_CGU0_DF_DIV=0
CONFIG_CGU0_VCO_MULT=80
CONFIG_CGU0_CCLK_DIV=2
CONFIG_CGU0_SCLK_DIV=4
CONFIG_CGU0_SCLK0_DIV=4
CONFIG_CGU0_SCLK1_DIV=2
CONFIG_CGU0_DCLK_DIV=2
CONFIG_CGU0_OCLK_DIV=16
CONFIG_CGU0_DIV_S1SELEX=6
CONFIG_CGU1_VCO_MULT=64
CONFIG_CGU1_DF_DIV=0
CONFIG_CGU1_CCLK_DIV=2
CONFIG_CGU1_SCLK_DIV=4
CONFIG_CGU1_SCLK0_DIV=4
CONFIG_CGU1_SCLK1_DIV=2
CONFIG_CGU1_DCLK_DIV=2
CONFIG_CGU1_OCLK_DIV=16
CONFIG_CGU1_DIV_S1SELEX=6
CONFIG_CDU0_CLKO0=1
CONFIG_CDU0_CLKO1=1
CONFIG_CDU0_CLKO2=1
CONFIG_CDU0_CLKO3=3
CONFIG_CDU0_CLKO4=3
CONFIG_CDU0_CLKO5=1
CONFIG_CDU0_CLKO6=1
CONFIG_CDU0_CLKO7=1
CONFIG_CDU0_CLKO8=3
CONFIG_CDU0_CLKO9=1
CONFIG_CDU0_CLKO10=1
CONFIG_CDU0_CLKO12=1
CONFIG_SYS_LOAD_ADDR=0x0
# CONFIG_SYS_MALLOC_CLEAR_ON_INIT is not set
CONFIG_FIT=y
CONFIG_FIT_SIGNATURE=y
CONFIG_LEGACY_IMAGE_FORMAT=y
CONFIG_BOARD_EARLY_INIT_F=y
CONFIG_SPL_BSS_MAX_SIZE=0x65536
CONFIG_SPL_BOOTROM_SUPPORT=y
CONFIG_SPL_I2C=y
CONFIG_SPL_DM_SPI_FLASH=y
CONFIG_SPL_OS_BOOT=y
CONFIG_SYS_SPL_ARGS_ADDR=0xA0000000
CONFIG_CMD_BOOTZ=y
CONFIG_CMD_DM=y
# CONFIG_CMD_PINMUX is not set
CONFIG_CMD_SPI=y
CONFIG_CMD_USB=y
CONFIG_CMD_DHCP=y
CONFIG_CMD_MII=y
# CONFIG_CMD_MDIO is not set
CONFIG_CMD_PING=y
CONFIG_CMD_EXT4=y
CONFIG_CMD_FAT=y
CONFIG_OF_EMBED=y
CONFIG_ENV_OVERWRITE=y
CONFIG_ENV_IS_IN_SPI_FLASH=y
CONFIG_IP_DEFRAG=y
CONFIG_SPL_DM_SEQ_ALIAS=y
CONFIG_GPIO_HOG=y
CONFIG_SPL_GPIO_HOG=y
CONFIG_DM_GPIO_LOOKUP_LABEL=y
CONFIG_SPL_DM_GPIO_LOOKUP_LABEL=y
CONFIG_MCP2301X_GPIO=y
CONFIG_DM_I2C=y
CONFIG_DM_I2C_GPIO=y
CONFIG_SYS_I2C_ADI=y
CONFIG_MTD=y
CONFIG_DM_SPI_FLASH=y
CONFIG_SF_DEFAULT_SPEED=10000000
CONFIG_SPI_FLASH_ISSI=y
CONFIG_SPI_FLASH_MTD=y
CONFIG_ETH_DESIGNWARE=y
CONFIG_PHY=y
CONFIG_PINCTRL=y
# CONFIG_PINCTRL_GENERIC is not set
CONFIG_SPL_PINCTRL=y
# CONFIG_SPL_PINCTRL_GENERIC is not set
CONFIG_SPECIFY_CONSOLE_INDEX=y
CONFIG_DM_SERIAL=y
CONFIG_SPI=y
CONFIG_DM_SPI=y
CONFIG_ADI_QSPI=y
CONFIG_CADENCE_QSPI=y
CONFIG_HAS_CQSPI_REF_CLK=y
CONFIG_CQSPI_REF_CLK=500000000
CONFIG_SPL_TIMER=y
CONFIG_USB=y
CONFIG_USB_DWC2=y
CONFIG_ADI_NOP_USB_XCEIV=y
CONFIG_USB_STORAGE=y
CONFIG_SPL_OF_LIBFDT_ASSUME_MASK=0x0
CONFIG_PARTITIONS=y
CONFIG_DOS_PARTITION=y
CONFIG_PARTITION_UUIDS=y
```

## configs/sc594-som-ezkit_defconfig
```kconfig
CONFIG_ARM=y
CONFIG_TARGET_SC594_SOM_EZKIT=y
CONFIG_SYS_TEXT_BASE=0xB2200000
CONFIG_SYS_MALLOC_F_LEN=0x8000
CONFIG_NR_DRAM_BANKS=1
CONFIG_ENV_SIZE=0x20000
CONFIG_ENV_OFFSET=0x80000
CONFIG_ENV_SECT_SIZE=0x20000
CONFIG_TARGET_SC594_EZKIT=y
CONFIG_SC_BOOT_MODE=2
CONFIG_FIT=y
CONFIG_FIT_SIGNATURE=y
CONFIG_LEGACY_IMAGE_FORMAT=y
# CONFIG_ADI_SPI3 is not set
CONFIG_CLKIN_HZ=25000000
CONFIG_CGU0_VCO_MULT=80
CONFIG_CGU0_DF_DIV=0
CONFIG_CGU0_CCLK_DIV=2
CONFIG_CGU0_SCLK_DIV=4
CONFIG_CGU0_SCLK0_DIV=4
CONFIG_CGU0_SCLK1_DIV=2
CONFIG_CGU0_DCLK_DIV=2
CONFIG_CGU0_OCLK_DIV=16
CONFIG_CGU0_DIV_S1SELEX=6
CONFIG_CGU1_VCO_MULT=64
CONFIG_CGU1_DF_DIV=0
CONFIG_CGU1_CCLK_DIV=2
CONFIG_CGU1_SCLK_DIV=4
CONFIG_CGU1_SCLK0_DIV=4
CONFIG_CGU1_SCLK1_DIV=2
CONFIG_CGU1_DCLK_DIV=2
CONFIG_CGU1_OCLK_DIV=16
CONFIG_CGU1_DIV_S1SELEX=6
CONFIG_CDU0_CLKO0=1
CONFIG_CDU0_CLKO1=1
CONFIG_CDU0_CLKO2=1
CONFIG_CDU0_CLKO3=3
CONFIG_CDU0_CLKO4=3
CONFIG_CDU0_CLKO5=1
CONFIG_CDU0_CLKO6=1
CONFIG_CDU0_CLKO7=1
CONFIG_CDU0_CLKO8=3
CONFIG_CDU0_CLKO9=1
CONFIG_CDU0_CLKO10=1
CONFIG_CDU0_CLKO12=1
CONFIG_DM_GPIO=y
CONFIG_MCP2301X_GPIO=y
CONFIG_DEFAULT_DEVICE_TREE="sc594-som-ezkit"
CONFIG_CMD_MMC=y
CONFIG_CMD_SF=y
CONFIG_CMD_SPI=y
CONFIG_CMD_USB=y
CONFIG_CMD_EXT2=y
CONFIG_CMD_FAT=y
CONFIG_CMD_FS_GENERIC=y
CONFIG_OF_CONTROL=y
CONFIG_OF_EMBED=y
CONFIG_ENV_IS_IN_SPI_FLASH=y
CONFIG_USE_ENV_SPI_BUS=y
CONFIG_ENV_SPI_BUS=0
CONFIG_USE_ENV_SPI_CS=y
CONFIG_ENV_SPI_CS=0
CONFIG_IP_DEFRAG=y
CONFIG_DM=y
CONFIG_DM_I2C=y
CONFIG_SYS_I2C_ADI=y
CONFIG_DM_SPI_FLASH=y
CONFIG_SF_DEFAULT_BUS=2
CONFIG_SF_DEFAULT_CS=1
CONFIG_ETH_DESIGNWARE=y
CONFIG_BAUDRATE=115200
CONFIG_SPECIFY_CONSOLE_INDEX=y
CONFIG_DM_SERIAL=y
CONFIG_SPI=y
CONFIG_DM_SPI=y
CONFIG_USB=y
CONFIG_USB_MUSB_HCD=y
CONFIG_OF_LIBFDT=y
```
