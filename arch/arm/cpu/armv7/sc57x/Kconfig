## board/adi/common/Kconfig
```kconfig
config SC57X
	bool "sc57x SoC"
	select CPU_V7A
	select COMMON_CLK_ADI_SC57X

config SC58X
	bool "sc58x SoC"
	select CPU_V7A
	select COMMON_CLK_ADI_SC58X

config SC59X
	bool "sc59x SoC"
	select SUPPORT_SPL
	select CPU_V7A
	select COMMON_CLK_ADI_SC594

config SC59X_64
	bool "sc59x SoC"
	select SUPPORT_SPL
	select ARM64
	select DM
	select DM_SERIAL
	select COMMON_CLK_ADI_SC598

config SC_BOOT_MODE
       int "SC5XX boot mode select"
       default 1
       range 0 7
       help
         Mode 0: do nothing, just idle
         Mode 1: boot ldr out of serial flash
         Mode 7: boot ldr over uart

config DEBUG_DUMP
	int
	default 1

config KALLSYMS
	int
	default 1

config SPI_IMG_SIZE
	hex
	default 0x80000

config SYS_GENERIC_BOARD
	bool
	default y

config SPI_MM_BASE
	hex
	default 0x60000000

config SYS_FLASH_BASE   
	hex
	default 0x60000000

config SPI_MM_SIZE
	hex
	default 0x20000000

config SYS_HUSH_PARSER
	bool
	default y

config SOFT_SWITCH
	bool
	default n

config ARCH_HEADER_IN_MACH
	bool
	default y

config BUILD_LDR
	bool
	default y

config SC5XX_BUS_WIDTH
	int
	default 4

config SMC_GCTL_VAL
	hex
	default 0x00000010

config SMC_B0CTL_VAL
	hex
	default 0x01007011

config SMC_B0TIM_VAL
	hex
	default 0x08170977

config SMC_B0ETIM_VAL
	hex
	default 0x00092231

config SYS_MEMTEST_RESERVE_SIZE
	hex
	default 0x400000

config MUSB_HCD
	bool
	default n

config MUSB_TIMEOUT
	int
	default 100000

config UART_CONSOLE
	int
	default 0

config UART4_SERIAL
	bool
	depends on DM_SERIAL
	default y

config WDT_ADI
	bool
	default y

config WATCHDOG_TIMEOUT_MSECS
	int
	default 30000

config DTBLOADADDR
	string

config DTBNAME
	string

config DW_PORTS
	int
	default 1

config ADI_FALCON
	bool "Enable Falcon Boot Mode Support"
	depends on SPL_OS_BOOT_UNCOMPRESSED
	default n
	help
		Enable Falcon Boot Mode Support

config ADI_SPL_FORCE_BMODE
	int "Force the SPL to use this BMODE device during next boot stage"
	default 0
	range 0 9
	depends on SPL
	help
	  Force the SPL to use this BMODE device during next boot stage.
	  For example, if booting via QSPI, we can force the second stage
	  Of the boot process to use other peripherals via:
	  1 = QSPI -> QSPI
	  5 = QSPI -> OSPI
	  6 = QSPI -> eMMC

config CLKIN_HZ
	int "CLKIN_HZ"
	default 25000000

config CGU0_DF_DIV
	int "CGU0_DF_DIV"

config CGU0_VCO_MULT
	int "CGU0_VCO_MULT"
	help
		VCO_MULT controls the MSEL (multiplier) bits in PLL_CTL
		Values can range from 0-127 (where 0 means 128)

config CGU0_CCLK_DIV
	int "CGU0_CCLK_DIV"
	help
		CCLK_DIV controls the core clock divider
		Values can range from 0-31 (where 0 means 32)
		CCLK = (CLKIN * VCO_MULT) / CCLK_DIV

config CGU0_SCLK_DIV
	int "CGU0_SCLK_DIV"
	help
		SCLK_DIV controls the system clock divider
		Values can range from 0-31 (where 0 means 32)
		SCLK = (CLKIN * VCO_MULT) / SYSCLK_DIV

config CGU0_SCLK0_DIV
	int "CGU0_SCLK0_DIV"
	help
		Values can range from 0-7 (where 0 means 8)
		SCLK0 = SCLK / SCLK0_DIV

config CGU0_SCLK1_DIV
	int "CGU0_SCLK1_DIV"
	help
		Values can range from 0-7 (where 0 means 8)
		SCLK1 = SCLK / SCLK1_DIV

config CGU0_DCLK_DIV
	int "CGU0_DCLK_DIV"
	help
		DCLK_DIV controls the DDR clock divider
		Values can range from 0-31 (where 0 means 32)

config CGU0_OCLK_DIV
	int "CGU0_OCLK_DIV"
	help
		OCLK_DIV controls the output clock divider
		Values can range from 0-127 (where 0 means 128)

if SC59X || SC59X_64
config CGU0_DIV_S1SELEX
	int "CGU0_DIV_S1SELEX"
endif

config CGU1_VCO_MULT
	int "CGU1_VCO_MULT"

config CGU1_DF_DIV
	int "CGU1_DF_DIV"

config CGU1_CCLK_DIV
	int "CGU1_CCLK_DIV"

config CGU1_SCLK_DIV
	int "CGU1_SCLK_DIV"

config CGU1_SCLK0_DIV
	int "CGU1_SCLK0_DIV"

config CGU1_SCLK1_DIV
	int "CGU1_SCLK1_DIV"

config CGU1_DCLK_DIV
	int "CGU1_DCLK_DIV"

config CGU1_OCLK_DIV
	int "CGU1_OCLK_DIV"

if SC59X_64
config CGU1_DIV_S0SELEX
	int "CGU1_DIV_S0SELEX"
endif

if SC59X || SC59X_64
config CGU1_DIV_S1SELEX
	int "CGU1_DIV_S1SELEX"
endif

config CDU0_CLKO0
	int "CDU0_CLKO0"

config CDU0_CLKO1
	int "CDU0_CLKO1"

config CDU0_CLKO2
	int "CDU0_CLKO2"

config CDU0_CLKO3
	int "CDU0_CLKO3"

config CDU0_CLKO4
	int "CDU0_CLKO4"

config CDU0_CLKO5
	int "CDU0_CLKO5"

config CDU0_CLKO6
	int "CDU0_CLKO6"

config CDU0_CLKO7
	int "CDU0_CLKO7"

config CDU0_CLKO8
	int "CDU0_CLKO8"

config CDU0_CLKO9
	int "CDU0_CLKO9"

if SC59X || SC59X_64
config CDU0_CLKO10
	int "CDU0_CLK10"
endif

if SC59X || SC59X_64
config CDU0_CLKO12
	int "CDU0_CLKO12"
endif

if SC59X_64
config CDU0_CLKO13
	int "CDU0_CLKO13"
endif

if SC59X_64
config CDU0_CLKO14
	int "CDU0_CLKO14"
endif

config ADI_GPIO
	default y

config PINCTRL_ADI
	default y

source "board/adi/sc598-som-ezkit/Kconfig"
source "board/adi/sc594-som-ezkit/Kconfig"
source "board/adi/sc589-ezkit/Kconfig"
source "board/adi/sc589-mini/Kconfig"
source "board/adi/sc584-ezkit/Kconfig"
source "board/adi/sc573-ezkit/Kconfig"
```

## board/adi/sc573-ezkit/Kconfig
```kconfig
# SPDX-License-Identifier: GPL-2.0-or-later
#
# (C) Copyright 2022 - Analog Devices, Inc.
#
# Written and/or maintained by Timesys Corporation
#
# Contact: Nathan Barrett-Morrison <nathan.morrison@timesys.com>
# Contact: Greg Malysa <greg.malysa@timesys.com>
#

if TARGET_SC573_EZKIT

config SYS_VENDOR
	default "adi"

config SYS_BOARD
	default "sc573-ezkit"

config SYS_CONFIG_NAME
	default "sc573-ezkit"

config LDR_CPU
	default "ADSP-SC573-0.0"

config MACH_TYPE
	default "MACH_TYPE_SC573_EZKIT"

config DEFAULT_DEVICE_TREE
	default "sc573-ezkit"

config SPL_MAX_SIZE
	default 0x20000 # 128KB

config ADI_IMAGE
	default "tiny"

config SPL_BSS_START_ADDR
	hex
	default 0x200A0000

config SPL_BSS_MAX_SIZE
	hex
	default 0x10000 # 64K

config SYS_SPL_MALLOC_START
	hex
	default 0x200B0000

config SYS_SPL_MALLOC_SIZE
	hex
	default 0x10000 # 64K

config SPL_STACK
	hex
	default 0x200D0000

config SPL_STACK_SIZE
	hex
	default 0x10000 # 64K

config CUSTOM_SYS_INIT_SP_ADDR
	hex
	default 0x8203f000

endif
```

## board/adi/sc584-ezkit/Kconfig
```kconfig
# SPDX-License-Identifier: GPL-2.0-or-later
#
# (C) Copyright 2022 - Analog Devices, Inc.
#
# Written and/or maintained by Timesys Corporation
#
# Contact: Nathan Barrett-Morrison <nathan.morrison@timesys.com>
# Contact: Greg Malysa <greg.malysa@timesys.com>
#

if TARGET_SC584_EZKIT

config SYS_VENDOR
	default "adi"

config LDR_CPU
	default	"ADSP-SC584-0.1"

config SYS_BOARD
	default "sc584-ezkit"

config SYS_CONFIG_NAME
	default "sc584-ezkit"

config MACH_TYPE
	default "MACH_TYPE_SC584_EZKIT"

config DEFAULT_DEVICE_TREE
	default "sc584-ezkit"

config SPL_MAX_SIZE
	default 0x20000 # 128KB

config ADI_IMAGE
	default "tiny"

config SPL_BSS_START_ADDR
	hex
	default 0x20080000

config SPL_BSS_MAX_SIZE
	hex
	default 0x10000 # 64K

config SYS_SPL_MALLOC_START
	hex
	default 0x20090000

config SYS_SPL_MALLOC_SIZE
	hex
	default 0x10000 # 64K

config SPL_STACK
	hex
	default 0x200B0000

config SPL_STACK_SIZE
	hex
	default 0x10000 # 64K

config CUSTOM_SYS_INIT_SP_ADDR
	hex
	default 0x8903f000

endif
```

## board/adi/sc589-ezkit/Kconfig
```kconfig
# SPDX-License-Identifier: GPL-2.0-or-later
#
# (C) Copyright 2022 - Analog Devices, Inc.
#
# Written and/or maintained by Timesys Corporation
#
# Contact: Nathan Barrett-Morrison <nathan.morrison@timesys.com>
# Contact: Greg Malysa <greg.malysa@timesys.com>
#

if TARGET_SC589_EZKIT

config SYS_VENDOR
	default "adi"

config LDR_CPU
	default	"ADSP-SC589-0.1"

config SYS_BOARD
	default "sc589-ezkit"

config SYS_CONFIG_NAME
	default "sc589"

config MACH_TYPE
	default "MACH_TYPE_SC589_EZKIT"

config SPL_MAX_SIZE
	default 0x20000 # 128KB

config ADI_IMAGE
	default "tiny"

config SPL_BSS_START_ADDR
	hex
	default 0x20080000

config SPL_BSS_MAX_SIZE
	hex
	default 0x10000 # 64K

config SYS_SPL_MALLOC_START
	hex
	default 0x20090000

config SYS_SPL_MALLOC_SIZE
	hex
	default 0x10000 # 64K

config SPL_STACK
	hex
	default 0x200B0000

config SPL_STACK_SIZE
	hex
	default 0x10000 # 64K

config CUSTOM_SYS_INIT_SP_ADDR
	hex
	default 0xC203f000

endif
```

## board/adi/sc589-mini/Kconfig
```kconfig
# SPDX-License-Identifier: GPL-2.0-or-later
#
# (C) Copyright 2024 - Analog Devices, Inc.

if TARGET_SC589_MINI

config SYS_VENDOR
	default "adi"

config LDR_CPU
	default	"ADSP-SC589-0.1"

config SYS_BOARD
	default "sc589-mini"

config SYS_CONFIG_NAME
	default "sc589"

config DEFAULT_DEVICE_TREE
	default "sc589-mini"

config SPL_MAX_SIZE
	default 0x20000 # 128KB

config ADI_IMAGE
	default "minimal"

config SPL_BSS_START_ADDR
	hex
	default 0x20080000

config SPL_BSS_MAX_SIZE
	hex
	default 0x10000 # 64K

config SYS_SPL_MALLOC_START
	hex
	default 0x20090000

config SYS_SPL_MALLOC_SIZE
	hex
	default 0x10000 # 64K

config SPL_STACK
	hex
	default 0x200B0000

config SPL_STACK_SIZE
	hex
	default 0x10000 # 64K

config TEXT_BASE
	hex
	default 0xC2200000

config CUSTOM_SYS_INIT_SP_ADDR
	hex
	default 0xC203f000

config SYS_LOAD_ADDR
	hex
	default 0x0

# SPL

config SPL_TEXT_BASE
	default 0x20080000

# SPI Flash

config SF_DEFAULT_BUS
	default 2

config SF_DEFAULT_CS
	default 1

config SF_DEFAULT_SPEED
	default 5000000

# Clocks

config CGU0_DF_DIV
	default 0

config CGU0_VCO_MULT
	default 18

config CGU0_CCLK_DIV
	default 1

config CGU0_SCLK_DIV
	default 2

config CGU0_SCLK0_DIV
	default 2

config CGU0_SCLK1_DIV
	default 2

config CGU0_DCLK_DIV
	default 1

config CGU0_OCLK_DIV
	default 3

config CGU1_VCO_MULT
	default 5

config CGU1_DF_DIV
	default 0

config CGU1_CCLK_DIV
	default 1

config CGU1_SCLK_DIV
	default 2

config CGU1_SCLK0_DIV
	default 2

config CGU1_SCLK1_DIV
	default 2

config CGU1_DCLK_DIV
	default 2

config CGU1_OCLK_DIV
	default 3

config CDU0_CLKO0
	default 1

config CDU0_CLKO1
	default 1

config CDU0_CLKO2
	default 1

config CDU0_CLKO3
	default 1

config CDU0_CLKO4
	default 1

config CDU0_CLKO5
	default 1

config CDU0_CLKO6
	default 1

config CDU0_CLKO7
	default 5

config CDU0_CLKO8
	default 1

config CDU0_CLKO9
	default 1

endif
```

## board/adi/sc594-som-ezkit/Kconfig
```kconfig
# SPDX-License-Identifier: GPL-2.0-or-later
#
# (C) Copyright 2024 - Analog Devices, Inc.

if TARGET_SC594_SOM_EZKIT

config SYS_VENDOR
	default "adi"

config LDR_CPU
	default "ADSP-SC594-0.0"

config SYS_BOARD
	default "sc594-som-ezkit"

config SYS_CONFIG_NAME
	default "sc594-som"

config DEFAULT_DEVICE_TREE
	default "sc594-som-ezkit"

config SPL_MAX_SIZE
	default 0x30000 # 256KB

config ADI_IMAGE
	default "minimal"

config SPL_BSS_START_ADDR
	hex
	default 0x200B0000

config SPL_BSS_MAX_SIZE
	hex
	default 0x10000 # 64K

config SYS_SPL_MALLOC_START
	hex
	default 0x200C0000

config SYS_SPL_MALLOC_SIZE
	hex
	default 0x10000 # 64K

config SPL_STACK
	hex
	default 0x200E4000

config SPL_STACK_SIZE
	hex
	default 0x14000 # 64K

config TEXT_BASE
	hex
	default 0xB2200000

config CUSTOM_SYS_INIT_SP_ADDR
	hex
	default 0xA003f000

config SYS_LOAD_ADDR
	hex
	default 0x0

# SPL

config SPL_TEXT_BASE
	hex
	default 0x20080000

config SPL_PAYLOAD_ARGS_ADDR
	hex
	default 0xA0000000

config SPL_OF_LIBFDT_ASSUME_MASK
	hex
	default 0x0

# SPI Flash

config SF_DEFAULT_BUS
	default 2

config SF_DEFAULT_CS
	default 1

config SF_DEFAULT_SPEED
	default 10000000

# Clocks

config CGU0_DF_DIV
	default 0

config CGU0_VCO_MULT
	default 80

config CGU0_CCLK_DIV
	default 2

config CGU0_SCLK_DIV
	default 4

config CGU0_SCLK0_DIV
	default 4

config CGU0_SCLK1_DIV
	default 2

config CGU0_DCLK_DIV
	default 2

config CGU0_OCLK_DIV
	default 16

config CGU0_DIV_S1SELEX
	default 6

config CGU1_VCO_MULT
	default 64

config CGU1_DF_DIV
	default 0

config CGU1_CCLK_DIV
	default 2

config CGU1_SCLK_DIV
	default 4

config CGU1_SCLK0_DIV
	default 4

config CGU1_SCLK1_DIV
	default 2

config CGU1_DCLK_DIV
	default 2

config CGU1_OCLK_DIV
	default 16

config CGU1_DIV_S1SELEX
	default 6

config CDU0_CLKO0
	default 1

config CDU0_CLKO1
	default 1

config CDU0_CLKO2
	default 1

config CDU0_CLKO3
	default 3

config CDU0_CLKO4
	default 3

config CDU0_CLKO5
	default 1

config CDU0_CLKO6
	default 1

config CDU0_CLKO7
	default 1

config CDU0_CLKO8
	default 3

config CDU0_CLKO9
	default 1

config CDU0_CLKO10
	default 1

config CDU0_CLKO12
	default 1

endif
```

## board/adi/sc598-som-ezkit/Kconfig
```kconfig
# SPDX-License-Identifier: GPL-2.0-or-later
#
# (C) Copyright 2022 - Analog Devices, Inc.
#
# Written and/or maintained by Timesys Corporation
#
# Contact: Nathan Barrett-Morrison <nathan.morrison@timesys.com>
# Contact: Greg Malysa <greg.malysa@timesys.com>
#

if TARGET_SC598_SOM_EZKIT

config SYS_VENDOR
	default "adi"

config LDR_CPU
	default "ADSP-SC598-0.0"

config SYS_BOARD
	default "sc598-som-ezkit"

config SYS_CONFIG_NAME
	default "sc598-som"

config MACH_TYPE
	default "MACH_TYPE_SC598_SOM_EZKIT"

config DEFAULT_DEVICE_TREE
	default "sc598-som-ezkit"

config SPL_MAX_SIZE
	default 0x30000 # 256KB

config ADI_IMAGE
	default "minimal"

config NR_DRAM_BANKS
	default 1

config SPL_BSS_START_ADDR
	hex
	default 0x200B0000

config SPL_BSS_MAX_SIZE
	hex
	default 0x10000 # 64K

config SYS_SPL_MALLOC_START
	hex
	default 0x200C0000

config SYS_SPL_MALLOC_SIZE
	hex
	default 0x10000 # 64K

config SPL_STACK
	hex
	default 0x200E4000

config SPL_STACK_SIZE
	hex
	default 0x14000 # 64K

config TEXT_BASE
	hex
	default 0x96000000

config CUSTOM_SYS_INIT_SP_ADDR
	hex
	default 0x96000000

config SYS_LOAD_ADDR
	hex
	default 0x0

# SPL

config SPL_TEXT_BASE
	default 0x20080000

config SPL_PAYLOAD_ARGS_ADDR
	hex
	default 0x99000000

config SPL_OF_LIBFDT_ASSUME_MASK
	hex
	default 0x0

# SPI Flash

config SF_DEFAULT_BUS
	default 2

config SF_DEFAULT_CS
	default 1

config SF_DEFAULT_SPEED
	default 10000000

# Clock Configs

config CGU0_DF_DIV
	default 0

config CGU0_VCO_MULT
	default 80

config CGU0_CCLK_DIV
	default 2

config CGU0_SCLK_DIV
	default 4

config CGU0_SCLK0_DIV
	default 4

config CGU0_SCLK1_DIV
	default 2

config CGU0_DCLK_DIV
	default 3

config CGU0_OCLK_DIV
	default 8

config CGU0_DIV_S1SELEX
	default 6

config CGU1_VCO_MULT
	default 72

config CGU1_DF_DIV
	default 0

config CGU1_CCLK_DIV
	default 16

config CGU1_SCLK_DIV
	default 8

config CGU1_SCLK0_DIV
	default 4

config CGU1_SCLK1_DIV
	default 2

config CGU1_DCLK_DIV
	default 18

config CGU1_OCLK_DIV
	default 16

config CGU1_DIV_S0SELEX
	default 36

config CGU1_DIV_S1SELEX
	default 90

endif
```

## board/adi/sc5xx-common/Kconfig
```kconfig
config ADI_SPI3
	bool "ADI SPI3 driver"
	default y if (CONFIG_SC58X || CONFIG_SC57X)

config ADI_GPIO2
	bool "ADI GPIO2 driver"
	default y
config CMD_SC57X_OTP
	bool
	default y

config DEBUG_DUMP
	int
	default 1

config KALLSYMS
	int
	default 1

config SPI_IMG_SIZE
	hex
	default 0x80000

config SYS_GENERIC_BOARD
	bool
	default y

config SPI_MM_BASE
	hex
	default 0x60000000

config SYS_FLASH_BASE   
	hex
	default 0x60000000

config SPI_MM_SIZE
	hex
	default 0x20000000

config SYS_HUSH_PARSER
	bool
	default y

config SOFT_SWITCH
	bool
	default n

config ARCH_HEADER_IN_MACH
	bool
	default y

config BUILD_LDR
	bool
	default y

config SC5XX_BUS_WIDTH
	int
	default 4

config CLKIN_HZ
	int
	default 25000000

config CLKIN_HALF
	int
	default 0

config SCLK1_DIV
	int
	default 2

config SMC_GCTL_VAL
	hex
	default 0x00000010

config SMC_B0CTL_VAL
	hex
	default 0x01007011

config SMC_B0TIM_VAL
	hex
	default 0x08170977

config SMC_B0ETIM_VAL
	hex
	default 0x00092231

config SYS_MEMTEST_RESERVE_SIZE
	hex
	default 0x400000

config DW_AUTONEG
	bool
	default y

config SYS_I2C_ADI
	bool
	default y

config MUSB_HCD
	bool
	default y

config MUSB_TIMEOUT
	int
	default 100000

config SYS_NO_FLASH
	bool
	default y

config UART_CONSOLE
	int
	default 0

config UART4_SERIAL
	bool
	depends on DM_SERIAL
	default y

config ADI_WATCHDOG
	bool
	default n

config WATCHDOG_TIMEOUT_MSECS
	int
	default 30000
```
