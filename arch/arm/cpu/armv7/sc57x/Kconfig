## configs/sc598-som-ezkit-falcon_defconfig
```kconfig
CONFIG_ARM=y
CONFIG_ARCH_SC5XX=y
CONFIG_SYS_TEXT_BASE=0x96000000
CONFIG_SPL_GPIO_SUPPORT=y
CONFIG_SPL_LIBCOMMON_SUPPORT=y
CONFIG_SPL_LIBGENERIC_SUPPORT=y
CONFIG_SYS_MALLOC_F_LEN=0x8000
CONFIG_NR_DRAM_BANKS=1
CONFIG_ENV_SIZE=0x20000
CONFIG_ENV_OFFSET=0xE0000
CONFIG_ENV_SECT_SIZE=0x20000
CONFIG_SC_BOOT_MODE=2
CONFIG_ADI_CARRIER_SOMCRR_EZKIT=y
CONFIG_CGU0_DF_DIV=0
CONFIG_CGU0_VCO_MULT=80
CONFIG_CGU0_CCLK_DIV=2
CONFIG_CGU0_SCLK_DIV=4
CONFIG_CGU0_SCLK0_DIV=4
CONFIG_CGU0_SCLK1_DIV=2
CONFIG_CGU0_DCLK_DIV=3
CONFIG_CGU0_OCLK_DIV=8
CONFIG_CGU0_DIV_S1SELEX=6
CONFIG_CGU1_VCO_MULT=72
CONFIG_CGU1_DF_DIV=0
CONFIG_CGU1_CCLK_DIV=16
CONFIG_CGU1_SCLK_DIV=8
CONFIG_CGU1_SCLK0_DIV=4
CONFIG_CGU1_SCLK1_DIV=2
CONFIG_CGU1_DCLK_DIV=18
CONFIG_CGU1_OCLK_DIV=16
CONFIG_CGU1_DIV_S0SELEX=36
CONFIG_CGU1_DIV_S1SELEX=90
CONFIG_CDU0_CLKO0=1
CONFIG_CDU0_CLKO1=1
CONFIG_CDU0_CLKO2=7
CONFIG_CDU0_CLKO3=1
CONFIG_CDU0_CLKO4=3
CONFIG_CDU0_CLKO5=1
CONFIG_CDU0_CLKO6=1
CONFIG_CDU0_CLKO7=1
CONFIG_CDU0_CLKO8=3
CONFIG_CDU0_CLKO9=1
CONFIG_CDU0_CLKO10=1
CONFIG_CDU0_CLKO12=1
CONFIG_CDU0_CLKO13=3
CONFIG_CDU0_CLKO14=3
CONFIG_ADI_FALCON=y
CONFIG_DM_GPIO=y
CONFIG_MCP2301X_GPIO=y
CONFIG_SPL_DM_SPI=y
CONFIG_SPL_TEXT_BASE=0x20080000
CONFIG_SPL_MMC_SUPPORT=y
CONFIG_SPL_SERIAL_SUPPORT=y
CONFIG_SPL=y
CONFIG_TARGET_SC598_SOM_EZKIT=y
CONFIG_SPL_SPI_FLASH_SUPPORT=y
CONFIG_SPL_SPI_SUPPORT=y
CONFIG_DEFAULT_DEVICE_TREE="sc598-som-ezkit"
CONFIG_FIT=y
CONFIG_FIT_SIGNATURE=y
CONFIG_SPL_FIT_SIGNATURE=y
CONFIG_SPL_LOAD_FIT_FULL=y
# CONFIG_USE_SPL_FIT_GENERATOR is not set
CONFIG_LEGACY_IMAGE_FORMAT=y
CONFIG_BOARD_EARLY_INIT_F=y
CONFIG_OF_BOARD_SETUP=y
CONFIG_SPL_BOOTROM_SUPPORT=y
CONFIG_SYS_MMCSD_RAW_MODE_U_BOOT_USE_SECTOR=y
CONFIG_SYS_MMCSD_RAW_MODE_U_BOOT_SECTOR=0
CONFIG_SPL_SHA1_SUPPORT=y
CONFIG_SPL_I2C_SUPPORT=y
CONFIG_SPL_DM_SPI_FLASH=y
CONFIG_SPL_OS_BOOT=y
CONFIG_SPL_OS_BOOT_UNCOMPRESSED=y
CONFIG_SPL_SPI_LOAD=y
CONFIG_CMD_DM=y
CONFIG_CMD_MMC=y
# CONFIG_CMD_PINMUX is not set
CONFIG_CMD_SPI=y
CONFIG_DEFAULT_SPI_BUS=2
CONFIG_CMD_USB=y
CONFIG_CMD_EXT4=y
CONFIG_CMD_EXT4_WRITE=y
CONFIG_DOS_PARTITION=y
CONFIG_OF_EMBED=y
CONFIG_ENV_OVERWRITE=y
CONFIG_ENV_IS_IN_SPI_FLASH=y
CONFIG_USE_ENV_SPI_BUS=y
CONFIG_ENV_SPI_BUS=2
CONFIG_USE_ENV_SPI_CS=y
CONFIG_ENV_SPI_CS=1
CONFIG_NETCONSOLE=y
CONFIG_IP_DEFRAG=y
CONFIG_SPL_DM_SEQ_ALIAS=y
CONFIG_GPIO_HOG=y
CONFIG_DM_GPIO_LOOKUP_LABEL=y
CONFIG_SPL_DM_GPIO_LOOKUP_LABEL=y
CONFIG_DM_I2C=y
CONFIG_SYS_I2C_ADI=y
CONFIG_MMC_BROKEN_CD=y
CONFIG_DM_MMC=y
CONFIG_MMC_SDHCI_ADI=y
CONFIG_MMC_SDHCI=y
CONFIG_MMC_SDHCI_ADMA=y
CONFIG_SPL_MMC_SDHCI_ADMA=y
CONFIG_DM_SPI_FLASH=y
CONFIG_SF_DEFAULT_BUS=2
CONFIG_SF_DEFAULT_CS=1
CONFIG_SF_DEFAULT_SPEED=10000000
CONFIG_ETH_DWMAC4=y
CONFIG_PHY=y
CONFIG_PINCTRL=y
# CONFIG_PINCTRL_GENERIC is not set
CONFIG_SPL_PINCTRL=y
# CONFIG_SPL_PINCTRL_GENERIC is not set
CONFIG_SPI=y
CONFIG_DM_SPI=y
CONFIG_ADI_SPI3_DM=y
CONFIG_USB=y
CONFIG_DM_USB=y
CONFIG_USB_DWC2=y
CONFIG_ADI_NOP_USB_XCEIV=y
CONFIG_SPL_OF_LIBFDT_ASSUME_MASK=0x0
```

## configs/sc598-som-ezkit-spl_defconfig
```kconfig
CONFIG_ARM=y
CONFIG_COUNTER_FREQUENCY=31250000
# CONFIG_ARM64_SUPPORT_AARCH32 is not set
CONFIG_ARCH_SC5XX=y
CONFIG_TEXT_BASE=0x96000000
CONFIG_SYS_MALLOC_F_LEN=0x14000
CONFIG_SPL_GPIO=y
CONFIG_SPL_LIBCOMMON_SUPPORT=y
CONFIG_SPL_LIBGENERIC_SUPPORT=y
CONFIG_NR_DRAM_BANKS=1
CONFIG_HAS_CUSTOM_SYS_INIT_SP_ADDR=y
CONFIG_CUSTOM_SYS_INIT_SP_ADDR=0x96000000
CONFIG_ENV_SIZE=0x20000
CONFIG_ENV_OFFSET=0x180000
CONFIG_ENV_SECT_SIZE=0x20000
CONFIG_DM_GPIO=y
CONFIG_SPL_DM_SPI=y
CONFIG_DEFAULT_DEVICE_TREE="sc598-som-ezkit"
CONFIG_SPL_TEXT_BASE=0x20080000
CONFIG_SPL_SERIAL=y
CONFIG_SPL=y
CONFIG_SC_BOOT_MODE=2
CONFIG_ADI_CARRIER_SOMCRR_EZKIT=y
CONFIG_CGU0_DF_DIV=0
CONFIG_CGU0_VCO_MULT=80
CONFIG_CGU0_CCLK_DIV=2
CONFIG_CGU0_SCLK_DIV=4
CONFIG_CGU0_SCLK0_DIV=4
CONFIG_CGU0_SCLK1_DIV=2
CONFIG_CGU0_DCLK_DIV=3
CONFIG_CGU0_OCLK_DIV=8
CONFIG_CGU0_DIV_S1SELEX=6
CONFIG_CGU1_VCO_MULT=72
CONFIG_CGU1_DF_DIV=0
CONFIG_CGU1_CCLK_DIV=16
CONFIG_CGU1_SCLK_DIV=8
CONFIG_CGU1_SCLK0_DIV=4
CONFIG_CGU1_SCLK1_DIV=2
CONFIG_CGU1_DCLK_DIV=18
CONFIG_CGU1_OCLK_DIV=16
CONFIG_CGU1_DIV_S0SELEX=36
CONFIG_CGU1_DIV_S1SELEX=90
CONFIG_CDU0_CLKO0=1
CONFIG_CDU0_CLKO1=1
CONFIG_CDU0_CLKO2=7
CONFIG_CDU0_CLKO3=1
CONFIG_CDU0_CLKO4=3
CONFIG_CDU0_CLKO5=1
CONFIG_CDU0_CLKO6=1
CONFIG_CDU0_CLKO7=1
CONFIG_CDU0_CLKO8=3
CONFIG_CDU0_CLKO9=1
CONFIG_CDU0_CLKO10=1
CONFIG_CDU0_CLKO12=1
CONFIG_CDU0_CLKO13=3
CONFIG_CDU0_CLKO14=3
CONFIG_SYS_LOAD_ADDR=0x0
CONFIG_FIT=y
#CONFIG_FIT_SIGNATURE=y
CONFIG_LEGACY_IMAGE_FORMAT=y
CONFIG_BOARD_EARLY_INIT_F=y
CONFIG_SPL_BSS_MAX_SIZE=0x65536
CONFIG_SPL_BOOTROM_SUPPORT=y
CONFIG_SYS_MMCSD_RAW_MODE_U_BOOT_USE_SECTOR=y
CONFIG_SYS_MMCSD_RAW_MODE_U_BOOT_SECTOR=0
CONFIG_SPL_I2C=y
CONFIG_SPL_DM_SPI_FLASH=y
CONFIG_SPL_OS_BOOT=y
CONFIG_SYS_SPL_ARGS_ADDR=0x99000000
CONFIG_CMD_DM=y
CONFIG_CMD_MMC=y
# CONFIG_CMD_PINMUX is not set
CONFIG_CMD_REMOTEPROC=y
CONFIG_CMD_SPI=y
CONFIG_DEFAULT_SPI_BUS=2
CONFIG_CMD_USB=y
CONFIG_CMD_DHCP=y
CONFIG_CMD_MII=y
# CONFIG_CMD_MDIO is not set
CONFIG_CMD_PING=y
CONFIG_CMD_DNS=y
CONFIG_CMD_EXT4=y
CONFIG_CMD_EXT4_WRITE=y
CONFIG_DOS_PARTITION=y
CONFIG_OF_EMBED=y
CONFIG_ENV_OVERWRITE=y
CONFIG_ENV_IS_IN_SPI_FLASH=y
CONFIG_NETCONSOLE=y
CONFIG_IP_DEFRAG=y
CONFIG_SPL_DM_SEQ_ALIAS=y
CONFIG_GPIO_HOG=y
CONFIG_SPL_GPIO_HOG=y
CONFIG_DM_GPIO_LOOKUP_LABEL=y
CONFIG_SPL_DM_GPIO_LOOKUP_LABEL=y
CONFIG_MCP2301X_GPIO=y
CONFIG_DM_I2C=y
CONFIG_DM_I2C_GPIO=y
CONFIG_SYS_I2C_ADI=y
CONFIG_MMC_BROKEN_CD=y
CONFIG_MMC_SDHCI_ADI=y
CONFIG_MMC_SDHCI=y
CONFIG_MMC_SDHCI_ADMA=y
CONFIG_MTD=y
CONFIG_DM_SPI_FLASH=y
CONFIG_SF_DEFAULT_BUS=2
CONFIG_SF_DEFAULT_CS=1
CONFIG_SF_DEFAULT_SPEED=10000000
CONFIG_SPI_FLASH_BAR=y
CONFIG_SPI_FLASH_ISSI=y
CONFIG_SPI_FLASH_MACRONIX=y
CONFIG_SPI_FLASH_MTD=y
CONFIG_ETH_DWMAC4=y
CONFIG_PHY=y
CONFIG_PINCTRL=y
# CONFIG_PINCTRL_GENERIC is not set
CONFIG_SPL_PINCTRL=y
# CONFIG_SPL_PINCTRL_GENERIC is not set
CONFIG_REMOTEPROC_ADI_SC5XX=y
CONFIG_SPI=y
CONFIG_DM_SPI=y
CONFIG_ADI_QSPI=y
CONFIG_CADENCE_QSPI=y
CONFIG_HAS_CQSPI_REF_CLK=y
CONFIG_CQSPI_REF_CLK=500000000
CONFIG_TIMER=y
CONFIG_SPL_TIMER=y
CONFIG_ADI_SC5XX_TIMER=y
CONFIG_USB=y
CONFIG_USB_DWC2=y
CONFIG_ADI_NOP_USB_XCEIV=y
CONFIG_SPL_OF_LIBFDT_ASSUME_MASK=0x0
```

## configs/sc598-som-ezkit_defconfig
```kconfig
CONFIG_ARM=y
CONFIG_SC59X_64=y
CONFIG_SYS_TEXT_BASE=0x90000000
CONFIG_NR_DRAM_BANKS=1
CONFIG_ENV_SIZE=0x20000
CONFIG_ENV_OFFSET=0xC0000
CONFIG_ENV_SECT_SIZE=0x20000
CONFIG_SC_BOOT_MODE=2
CONFIG_FIT=y
CONFIG_FIT_SIGNATURE=y
CONFIG_LEGACY_IMAGE_FORMAT=y
CONFIG_CLKIN_HZ=25000000
CONFIG_CGU0_VCO_MULT=80
CONFIG_CGU0_DF_DIV=0
CONFIG_CGU0_CCLK_DIV=2
CONFIG_CGU0_SCLK_DIV=4
CONFIG_CGU0_SCLK0_DIV=4
CONFIG_CGU0_SCLK1_DIV=2
CONFIG_CGU0_DCLK_DIV=3
CONFIG_CGU0_OCLK_DIV=8
CONFIG_CGU0_DIV_S1SELEX=6
CONFIG_CGU1_VCO_MULT=72
CONFIG_CGU1_DF_DIV=0
CONFIG_CGU1_CCLK_DIV=16
CONFIG_CGU1_SCLK_DIV=8
CONFIG_CGU1_SCLK0_DIV=4
CONFIG_CGU1_SCLK1_DIV=2
CONFIG_CGU1_DCLK_DIV=18
CONFIG_CGU1_OCLK_DIV=16
CONFIG_CGU1_DIV_S0SELEX=36
CONFIG_CGU1_DIV_S1SELEX=90
CONFIG_CDU0_CLKO0=1
CONFIG_CDU0_CLKO1=1
CONFIG_CDU0_CLKO2=7
CONFIG_CDU0_CLKO3=1
CONFIG_CDU0_CLKO4=3
CONFIG_CDU0_CLKO5=1
CONFIG_CDU0_CLKO6=1
CONFIG_CDU0_CLKO7=1
CONFIG_CDU0_CLKO8=3
CONFIG_CDU0_CLKO9=1
CONFIG_CDU0_CLKO10=1
CONFIG_CDU0_CLKO12=1
CONFIG_CDU0_CLKO13=3
CONFIG_CDU0_CLKO14=3
CONFIG_MMC_DW=y
CONFIG_DEFAULT_DEVICE_TREE="sc598-som-ezkit"
# CONFIG_SYS_MALLOC_F is not set
CONFIG_CMD_DM=y
CONFIG_CMD_MMC=y
CONFIG_CMD_SPI=y
CONFIG_CMD_USB=y
CONFIG_CMD_EXT4=y
CONFIG_CMD_EXT4_WRITE=y
CONFIG_DOS_PARTITION=y
CONFIG_OF_CONTROL=y
CONFIG_OF_EMBED=y
CONFIG_ENV_IS_IN_SPI_FLASH=y
CONFIG_USE_ENV_SPI_BUS=y
CONFIG_ENV_SPI_BUS=2
CONFIG_USE_ENV_SPI_CS=y
CONFIG_ENV_SPI_CS=1
CONFIG_NETCONSOLE=y
CONFIG_IP_DEFRAG=y
CONFIG_DM=y
CONFIG_CLK=y
CONFIG_MMC_BROKEN_CD=y
CONFIG_DM_MMC=y
CONFIG_MMC_SDHCI_ADI=y
CONFIG_MMC_SDHCI=y
CONFIG_MMC_SDHCI_ADMA=y
CONFIG_DM_SPI_FLASH=y
CONFIG_ETH_DWMAC4=y
CONFIG_PHY=y
CONFIG_BAUDRATE=115200
CONFIG_SPI=y
CONFIG_DM_SPI=y
CONFIG_USB=y
CONFIG_DM_USB=y
CONFIG_USB_DWC2=y
CONFIG_ADI_NOP_USB_XCEIV=y
```

## drivers/usb/phy/Kconfig
```kconfig
# SPDX-License-Identifier: GPL-2.0+
#
# (C) Copyright 2017
# Adam Ford, Logic PD, aford173@gmail.com

comment "USB Phy"

config TWL4030_USB
	bool "TWL4030 PHY"

config OMAP_USB_PHY
	bool "OMAP PHY"

config ROCKCHIP_USB2_PHY
	bool "Rockchip USB2 PHY"

config ADI_NOP_USB_XCEIV
	bool "NOP USB Transceiver Driver"
	depends on PHY
	help
	  This driver is to be used by all the usb transceiver which are either
	  built-in with usb ip or which are autonomous and doesn't require any
	  phy programming such as ISP1x04 etc.
```
